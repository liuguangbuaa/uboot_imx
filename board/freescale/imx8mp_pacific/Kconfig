## board/freescale/imx8mp_pacific/Kconfig
```kconfig
if TARGET_IMX8MP_PACIFIC || TARGET_IMX8MP_DDR4_EVK

config SYS_BOARD
	default "imx8mp_pacific"

config SYS_VENDOR
	default "freescale"

config SYS_CONFIG_NAME
	default "imx8mp_pacific"

config IMX_CONFIG
	default "board/freescale/imx8mp_pacific/imximage-8mp-lpddr4.cfg"

source "board/freescale/common/Kconfig"

endif
```
